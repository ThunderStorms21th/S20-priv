## arch/arm64/configs/ts_defconfig
```kconfig
## GENERAL THUNDERSTORMS CONFIG

CONFIG_LOCALVERSION="-ThunderStormS-v2.3-HVC6-OneUI4.1"
CONFIG_LOCALVERSION_AUTO=n

## MAIN
CONFIG_MALI_KUTF=y
# CONFIG_VISION_UNITTEST is not set
# CONFIG_CRYPTO_TEST is not set
# CONFIG_ARM_EXYNOS_DEVFREQ_DEBUG is not set
# CONFIG_SLUB_DEBUG is not set
# CONFIG_CMA_DEBUGFS is not set
# CONFIG_CMUCAL_DEBUG is not set
# CONFIG_PHY_EXYNOS_DEBUGFS is not set
# CONFIG_PHY_EXYNOS_DP_DEBUGFS is not set
# CONFIG_DEBUG_ATOMIC_SLEEP is not set
# CONFIG_MMC_DW_DEBUG is not set
# CONFIG_TOUCHSCREEN_DUMP_MODE is not set
# CONFIG_EXYNOS_SNAPSHOT_DM is not set

## GPU
CONFIG_MALI_DDK_VERSION=y
# CONFIG_MALI_VALHALL_R17P0 is not set
# CONFIG_MALI_VALHALL_R19P0 is not set
# CONFIG_MALI_VALHALL_R20P0 is not set
# CONFIG_MALI_VALHALL_R25P1 is not set
# CONFIG_MALI_DDK_VALHALL_R32P1 is not set
# CONFIG_MALI_DDK_VALHALL_R33P0 is not set
# CONFIG_MALI_DDK_VALHALL_R35P0 is not set
CONFIG_MALI_DDK_VALHALL_R36P0=y

## OPTIMIZE KERNEL FOR SIZE and PERFORMANCE
CONFIG_CC_OPTIMIZE_FOR_PERFORMANCE=y
# CONFIG_CC_OPTIMIZE_FOR_SIZE is not set

## ZSMALLOG mapping
# CONFIG_PGTABLE_MAPPING is not set

# COMPRESS SECTION
# CONFIG_RD_BZIP2 is not set
# CONFIG_RD_LZMA is not set
# CONFIG_RD_XZ is not set
# CONFIG_RD_LZO is not set
# CONFIG_RD_LZ4 is not set

## HZ TICK
# CONFIG_HZ_50 is not set
# CONFIG_HZ_100 is not set
CONFIG_HZ_200=y
CONFIG_HZ_250 is not set
# CONFIG_HZ_300 is not set
# CONFIG_HZ_1000 is not set
CONFIG_HZ=200

## NOATIME FOR MOUNT
CONFIG_DEFAULT_MNT_NOATIME=y
# CONFIG_DEFAULT_MNT_RELATIME is not set

## CIFS
CONFIG_NETWORK_FILESYSTEMS=y
CONFIG_CIFS=y
CONFIG_CIFS_STATS=y
CONFIG_CIFS_ALLOW_INSECURE_LEGACY=y
# CONFIG_CIFS_WEAK_PW_HASH is not set
# CONFIG_CIFS_UPCALL is not set
CONFIG_CIFS_XATTR=y
CONFIG_CIFS_POSIX=y
CONFIG_CIFS_ACL=y
# CONFIG_CIFS_DEBUG is not set
# CONFIG_CIFS_DEBUG2 is not set
# CONFIG_CIFS_DEBUG_DUMP_KEYS is not set
# CONFIG_CIFS_DFS_UPCALL is not set
# CONFIG_CIFS_SMB311 is not set
CONFIG_CRYPTO_CCM=y
CONFIG_CRYPTO_MD4=y

## NTFS R/W
CONFIG_NTFS_FS=y
# CONFIG_NTFS_DEBUG is not set
CONFIG_NTFS_RW=y

## CPU MASKS
CONFIG_LITTLE_CPU_MASK=15
CONFIG_BIG_CPU_MASK=48
CONFIG_PRIME_CPU_MASK=192

## WAKELOCKS
CONFIG_BOEFFLA_WL_BLOCKER=y

## STORAGE MASS
CONFIG_USB_F_MASS_STORAGE=y
CONFIG_USB_CONFIGFS_MASS_STORAGE=y
CONFIG_USB_OTG=y

## SAMSUNG MTP - only enable for OneUI
CONFIG_USB_ANDROID_SAMSUNG_MTP=y

## PELT tunables
# CONFIG_PELT_UTIL_HALFLIFE_32 is not set
CONFIG_PELT_UTIL_HALFLIFE_16=y
# CONFIG_PELT_UTIL_HALFLIFE_8 is not set

## TCP
CONFIG_TCP_CONG_ADVANCED=y
CONFIG_TCP_CONG_BIC=y
CONFIG_TCP_CONG_VEGAS=y
CONFIG_TCP_CONG_RENO=y
CONFIG_TCP_CONG_NV=y
CONFIG_TCP_CONG_SCALABLE=y
CONFIG_TCP_CONG_LP=y
CONFIG_TCP_CONG_VENO=y
CONFIG_TCP_CONG_YEAH=y
CONFIG_TCP_CONG_ILLINOIS=y
CONFIG_TCP_CONG_WESTWOOD=y
CONFIG_TCP_CONG_HTCP=y
CONFIG_TCP_CONG_BBR=y
CONFIG_TCP_CONG_CUBIC=y

## TCP WINDOW 64kb
CONFIG_LARGE_TCP_INITIAL_BUFFER=y

## TTL FILTER - enabled
CONFIG_NETFILTER_XT_TARGET_HL=y
CONFIG_IP_NF_TARGET_TTL=y
CONFIG_IP6_NF_MATCH_HL=y
CONFIG_IP6_NF_TARGET_HL=y

## DISPLAY LOGS
CONFIG_SEC_DEBUG_TSP_LOG=y

## WQ_POWER_EFFICIENT
CONFIG_WQ_POWER_EFFICIENT_DEFAULT=y

## DISPLAYPORT_DEX_FORCE_WQHD
CONFIG_DISPLAYPORT_DEX_FORCE_WQHD=y

## USB SERIAL
CONFIG_USB_SERIAL_CONSOLE=y
CONFIG_USB_SERIAL_GENERIC=y
# natively support nodemcu/arduino serial console
CONFIG_USB_SERIAL_CP210X=y

## FIPS
# CONFIG_EXYRNG_FIPS_COMPLIANCE is not set
# CONFIG_EXYRNG_FAIL_POLICY_RESET is not set
# CONFIG_CRYPTO_FIPS is not set
# CONFIG_EXYNOS_FMP_FIPS is not set

## FRANDOM
CONFIG_FRANDOM=y

## F2FS DEBUG
# CONFIG_F2FS_SEC_BLOCK_OPERATIONS_DEBUG is not set

## STORAGE LOGS
# CONFIG_BLOCK_SUPPORT_STLOG is not set

## VM MAX READAHEAD
CONFIG_VM_MAX_READAHEAD=128

## IO Schedulers
CONFIG_IOSCHED_NOOP=y
CONFIG_IOSCHED_DEADLINE=y
CONFIG_IOSCHED_CFQ=y
CONFIG_IOSCHED_ZEN=y
CONFIG_IOSCHED_MAPLE=y
CONFIG_IOSCHED_FIOPS=y
CONFIG_IOSCHED_SIO=y
CONFIG_DEFAULT_CFQ=y
# CONFIG_DEFAULT_NOOP is not set
CONFIG_DEFAULT_IOSCHED="cfq"
CONFIG_MQ_IOSCHED_DEADLINE=y
CONFIG_MQ_IOSCHED_KYBER=y
# CONFIG_IOSCHED_BFQ is not set

## CPU GOVERNORS
CONFIG_CPU_FREQ_DEFAULT_GOV_ENERGYSTEP=y
CONFIG_CPU_FREQ_GOV_ENERGYSTEP=y
CONFIG_CPU_FREQ_GOV_PERFORMANCE=y
CONFIG_CPU_FREQ_GOV_SCHEDUTIL=y
CONFIG_CPU_FREQ_GOV_ONDEMAND=y
CONFIG_CPU_FREQ_GOV_POWERSAVE=y
CONFIG_CPU_FREQ_GOV_CONSERVATIVE=y

## BLK_DEV_LOOP_MIN_COUNT -fix mount in TWRP : 32
CONFIG_BLK_DEV_LOOP_MIN_COUNT=24

## POWERSUSPEND
CONFIG_POWERSUSPEND=y
# CONFIG_POWERSUSPEND_DEBUG is not set

## CFS_BANDWITH - can makes too much cpu's thrrottling
# CONFIG_CFS_BANDWIDTH is not set

CONFIG_WIREGUARD=y
# CONFIG_WIREGUARD_DEBUG is not set
CONFIG_NET_UDP_TUNNEL=y
# CONFIG_GENEVE is not set
# CONFIG_GTP is not set

## BATTERY SAVER
CONFIG_BATTERY_SAVER=y

## Virtual Machine for Exynos
CONFIG_VIRTUALIZATION=y
CONFIG_KVM=y
CONFIG_PREEMPT_NOTIFIERS=y
CONFIG_ARM64_ERRATUM_834220=y
CONFIG_MMU_NOTIFIER=y
CONFIG_HAVE_KVM_IRQCHIP=y
CONFIG_HAVE_KVM_IRQFD=y
CONFIG_HAVE_KVM_IRQ_ROUTING=y
CONFIG_HAVE_KVM_EVENTFD=y
CONFIG_KVM_MMIO=y
CONFIG_HAVE_KVM_MSI=y
CONFIG_HAVE_KVM_CPU_RELAX_INTERCEPT=y
CONFIG_KVM_VFIO=y
CONFIG_HAVE_KVM_ARCH_TLB_FLUSH_ALL=y
CONFIG_KVM_GENERIC_DIRTYLOG_READ_PROTECT=y
CONFIG_KVM_COMPAT=y
CONFIG_HAVE_KVM_IRQ_BYPASS=y
CONFIG_KVM_ARM_HOST=y
CONFIG_KVM_ARM_PMU=y
CONFIG_ARM64_VHE=y
# CONFIG_VHOST_NET is not set
# CONFIG_VHOST_CROSS_ENDIAN_LEGACY is not set

# KVM Guest
CONFIG_KVM_GUEST=y
CONFIG_KVM_DEBUG_FS=y
CONFIG_NET=y
CONFIG_NET_CORE=y
CONFIG_NETDEVICES=y
CONFIG_BLOCK=y
CONFIG_BLK_DEV=y
CONFIG_NETWORK_FILESYSTEMS=y
CONFIG_INET=y
CONFIG_TTY=y
## CONFIG_SERIAL_8250=y
## CONFIG_SERIAL_8250_CONSOLE=y
CONFIG_IP_PNP=y
CONFIG_IP_PNP_DHCP=y
CONFIG_BINFMT_ELF=y
CONFIG_PCI=y
CONFIG_PCI_MSI=y
CONFIG_DEBUG_KERNEL=y
CONFIG_HYPERVISOR_GUEST=y
CONFIG_PARAVIRT=y
CONFIG_VIRTIO=y
CONFIG_VIRTIO_PCI=y
CONFIG_VIRTIO_BLK=y
CONFIG_VIRTIO_CONSOLE=y
CONFIG_VIRTIO_NET=y
CONFIG_9P_FS=y
CONFIG_NET_9P=y
CONFIG_NET_9P_VIRTIO=y
CONFIG_SCSI_LOWLEVEL=y
CONFIG_SCSI_VIRTIO=y
CONFIG_VIRTIO_INPUT=y
CONFIG_DRM_VIRTIO_GPU=y

# Docker
CONFIG_BRIDGE=y
CONFIG_BRIDGE_NETFILTER=y
CONFIG_NETFILTER_XT_MATCH_ADDRTYPE=y
CONFIG_NETFILTER_XT_MATCH_IPVS=y
## CONFIG_CFQ_GROUP_IOSCHED=y
CONFIG_BLK_CGROUP=y
CONFIG_BLK_DEV_THROTTLING=y
CONFIG_CGROUP_PERF=y
CONFIG_CGROUP_HUGETLB=y
CONFIG_CGROUP_NET_PRIO=y
CONFIG_IP_VS=y
CONFIG_IP_VS_NFCT=y
CONFIG_IP_VS_PROTO_TCP=y
CONFIG_IP_VS_PROTO_UDP=y
CONFIG_IP_VS_RR=y
CONFIG_SECURITY_APPARMOR=y
CONFIG_EXT3_FS_XATTR=y
CONFIG_EXT3_FS_POSIX_ACL=y
CONFIG_VXLAN=y
CONFIG_BRIDGE_VLAN_FILTERING=y
CONFIG_IPVLAN=y
CONFIG_MACVLAN=y
CONFIG_DUMMY=y
CONFIG_OVERLAY_FS=y

## NETWORK SIGNAL GURU
CONFIG_IP_SCTP=y
# CONFIG_SCTP_DBG_OBJCNT is not set
CONFIG_SCTP_DEFAULT_COOKIE_HMAC_MD5=y
# CONFIG_SCTP_DEFAULT_COOKIE_HMAC_SHA1 is not set
# CONFIG_SCTP_DEFAULT_COOKIE_HMAC_NONE is not set
CONFIG_SCTP_COOKIE_HMAC_MD5=y
# CONFIG_SCTP_COOKIE_HMAC_SHA1 is not set
CONFIG_INET_SCTP_DIAG=y

## CPU SET SETTINGS
CONFIG_CPUSET_ASSIST=y
CONFIG_CPUSET_BG="0-1"
CONFIG_CPUSET_AUDIO_APP="1-2"
CONFIG_CPUSET_CAMERA="0-3,6-7"
CONFIG_CPUSET_FG="0-3,5-6"
CONFIG_CPUSET_RESTRICTED="0-3"
CONFIG_CPUSET_TOP_APP="0-7"
CONFIG_CPUSET_SYSTEM_BG="0-3"

## MISMATCH CONFIG
CONFIG_DEBUG_SECTION_MISMATCH=y
```
